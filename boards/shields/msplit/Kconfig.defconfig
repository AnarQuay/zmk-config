## boards/shields/msplit/Kconfig.defconfig
```kconfig
if SHIELD_MSPLIT_LEFT

config ZMK_SPLIT_ROLE_CENTRAL
    default y

endif # SHIELD_MSPLIT_LEFT

if SHIELD_MSPLIT_LEFT || SHIELD_MSPLIT_RIGHT || SHIELD_MSPLIT_MACRO

config ZMK_SPLIT
    default y

endif # SHIELD_MSPLIT_LEFT || SHIELD_MSPLIT_RIGHT || SHIELD_MSPLIT_MACRO
```

## boards/shields/msplit/Kconfig.shield
```kconfig
config SHIELD_MSPLIT_LEFT
    def_bool $(shields_list_contains,msplit_left)

config SHIELD_MSPLIT_RIGHT
    def_bool $(shields_list_contains,msplit_right)

config SHIELD_MSPLIT_MACRO
    def_bool $(shields_list_contains,msplit_macro)
```
